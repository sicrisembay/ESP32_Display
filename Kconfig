## Kconfig
```kconfig
config ESP32_DISPLAY
    bool "Enable Display"
    default y

menu "Display Interface Configuration"
    depends on ESP32_DISPLAY
    choice
        prompt "Display SPI Inteface"
        default DISPLAY_4WIRE_SPI
        config DISPLAY_3WIRE_SPI
            bool "3-wire SPI"
        config DISPLAY_4WIRE_SPI
            bool "4-wire SPI" 
    endchoice

    config DISPLAY_SPI_HOST_DEV
        int "ESP32 SPI Host (1:HSPI, 2:VSPI)"
        range 1 2
        default 1
    config DISPLAY_SPI_CLK_FREQ
        int "SPI Clock Frequency, Hz"
        default 40000000
    config DISPLAY_SPI_CLK_IO_PIN
        int "LCD SPI Clock IO pin"
        default 19
    config DISPLAY_SPI_SDI_IO_PIN
        int "LCD SPI SDI IO pin"
        default -1 if DISPLAY_3WIRE_SPI
        default 18 if DISPLAY_4WIRE_SPI
    config DISPLAY_SPI_SDO_IO_PIN
        int "LCD SPI SDO IO pin"
        default 23
    config DISPLAY_SPI_CS_IO_PIN
        int "LCD SPI CS IO pin"
        default 22
    config DISPLAY_DCX_IO_PIN
        depends on DISPLAY_4WIRE_SPI
        int "LCD Data/Command IO pin"
        default 21
    config DISPLAY_RESET_IO_PIN
        int "LCD Reset IO pin"
        default 0
    config DISPLAY_BACKLIGHT_IO_PIN
        int "LCD Backlight IO pin"
        default 2
endmenu # "Display Interface Configuration"

config DISPLAY_H_RES
    depends on ESP32_DISPLAY
    int "Horizontal Resolution in pixel"
    default 480

config DISPLAY_V_RES
    depends on ESP32_DISPLAY
    int "Vertical Resolution in pixel"
    default 320

config DISPLAY_PARALLEL_LINE_COUNT
    depends on ESP32_DISPLAY
    int "Number of Horizontal lines the buffer can hold"
    default 16

choice
    depends on ESP32_DISPLAY
    prompt "Display Color"
    default DISPLAY_COLOR_RGB565
    config DISPLAY_COLOR_RGB565
        bool "RGB565"
    config DISPLAY_COLOR_ARGB8888
        bool "ARGB8888"
endchoice

choice DISPLAY_DRIVER_IC
    depends on ESP32_DISPLAY
    prompt "Display Driver IC"
    default DISPLAY_ST7796S
    config DISPLAY_ILI9488
        bool "ILI9488"
    config DISPLAY_ST7796S
        bool "ST7796S"
endchoice

rsource "ili9488/Kconfig"
rsource "st7796s/Kconfig"
```

## ili9488/Kconfig
```kconfig
menu "ILI9488 Configuration"
    depends on DISPLAY_ILI9488
    
endmenu # "ILI9488 Configuration"
```

## st7796s/Kconfig
```kconfig
menu "ST7796S Configuration"
    depends on DISPLAY_ST7796S
endmenu # "ST7796S Configuration"
```

## test/ST7796S/main/Kconfig
```kconfig
menu "ESP32 Display Configuration"
source "${ESP32_DISPLAY_PATH}/Kconfig"
endmenu
```
